## CMakeLists.txt
```
# # SPDX-License-Identifier: Apache-2.0

cmake_minimum_required(VERSION 3.20.0)

find_package(Zephyr REQUIRED HINTS $ENV{ZEPHYR_BASE})
project(xnnpack)

# Include XNNPack
set(XNNPACK_DIR ${CMAKE_SOURCE_DIR}/../../../modules/xnnpack)
add_subdirectory(${XNNPACK_DIR} xnnpack_build)

# Link XNNPack to the Zephyr application
target_link_libraries(app PRIVATE XNNPACK pthreadpool cpuinfo)

include_directories(${XNNPACK_DIR}/include)

# Disable JIT (not needed on RISC-V)
set(XNN_ENABLE_JIT OFF CACHE BOOL "Disable JIT compilation")

# Enable threading for XNNPack
set(XNN_ENABLE_THREADPOOL ON CACHE BOOL "Enable multithreading in XNNPack")

# Set CPU info (minimal for RISC-V, will likely stub it later)
set(XNNPACK_USE_SYSTEM_LIBS OFF CACHE BOOL "Disable system libraries for CPU detection")

# Disable tests to skip building googletest and googlebenchmark
set(XNNPACK_BUILD_TESTS OFF CACHE BOOL "Disable building XNNPack tests")
set(XNNPACK_BUILD_BENCHMARKS OFF CACHE BOOL "Disable building XNNPack tests")

# set(XNNPACK_LIBRARY_TYPE "static" CACHE STRING "Build a Static Library")
# set(XNNPACK_BUILD_LIBRARY ON CACHE BOOL "Build XNNPack as a library")

target_sources(app PRIVATE src/main.c)

# SPDX-License-Identifier: Apache-2.0

# # SPDX-License-Identifier: Apache-2.0

# cmake_minimum_required(VERSION 3.20.0)

# find_package(Zephyr REQUIRED HINTS $ENV{ZEPHYR_BASE})
# project(xnnpack)

# # Include XNNPack
# set(XNNPACK_DIR ${CMAKE_SOURCE_DIR}/../../../modules/xnnpack)

# # Ensure dependencies (cpuinfo, pthreadpool, etc.) are available
# # set(CPUINFO_SOURCE_DIR "${CMAKE_BINARY_DIR}/cpuinfo-source" CACHE STRING "cpuinfo source directory")
# # set(PTHREADPOOL_SOURCE_DIR "${CMAKE_BINARY_DIR}/pthreadpool-source" CACHE STRING "pthreadpool source directory")
# # set(FXDIV_SOURCE_DIR "${CMAKE_BINARY_DIR}/FXdiv-source" CACHE STRING "FXdiv source directory")

# # Prevent XNNPack from building a standalone library, just collect its sources
# set(XNNPACK_BUILD_LIBRARY OFF CACHE BOOL "Disable XNNPack standalone build")
# add_subdirectory(${XNNPACK_DIR} xnnpack_build)

# # Ensure XNNPack's source variables are defined
# if(NOT DEFINED OPERATOR_SRCS OR NOT DEFINED REFERENCE_SRCS OR NOT DEFINED SUBGRAPH_SRCS OR
#    NOT DEFINED LOGGING_SRCS OR NOT DEFINED XNNPACK_SRCS OR NOT DEFINED TABLE_SRCS)
#     message(FATAL_ERROR "XNNPack source variables are not defined! Make sure XNNPack's CMakeLists.txt is processed first.")
# endif()

# # Collect all XNNPack sources
# set(XNNPACK_ALL_SRCS
#     ${OPERATOR_SRCS}
#     ${REFERENCE_SRCS}
#     ${SUBGRAPH_SRCS}
#     ${LOGGING_SRCS}
#     ${XNNPACK_SRCS}
#     ${TABLE_SRCS}
# )

# # Include required directories
# include_directories(
#     ${XNNPACK_DIR}/include
#     ${XNNPACK_DIR}/src
#     ${CPUINFO_SOURCE_DIR}/include
#     ${PTHREADPOOL_SOURCE_DIR}/include
# )

# # Ensure Zephyr compiles XNNPack sources
# target_sources(app PRIVATE src/main.c ${XNNPACK_ALL_SRCS})

# # Link required dependencies
# target_link_libraries(app PRIVATE pthreadpool cpuinfo)
# # target_link_libraries(app PRIVATE)
```

## sample.yaml
```
sample:
  description: XNNPack DNN library example
  name: xnnpack 
common:
  tags: tinyml 
  integration_platforms:
    - native_sim
  harness: console
```

## prj.conf
```kconfig
CONFIG_PTHREAD_IPC=y
CONFIG_PTHREAD=y
CONFIG_PTHREAD_MUTEX=y
CONFIG_POSIX_API=y
CONFIG_MULTITHREADING=y
CONFIG_FPU=y
CONFIG_HEAP_MEM_POOL_SIZE=16384 

CONFIG_NEWLIB_LIBC=y
CONFIG_COMMON_LIBC_MALLOC=y
CONFIG_PICOLIBC=y
CONFIG_CPP=y
CONFIG_GLIBCXX_LIBCPP=y

# CONFIG_LOG=y
```

## src/main.c
```c
/*
 * Copyright (c) 2012-2014 Wind River Systems, Inc.
 *
 * SPDX-License-Identifier: Apache-2.0
 */

#include <stdio.h>
#include <stdint.h>
#include <xnnpack.h>  // Include XNNPack headers
#include <math.h>

// Temp: tohost/fromhost symbols for Chipyard usage
typedef struct {
  volatile uint64_t *tohost;
  volatile uint64_t *fromhost;
} HTIF_Type;

volatile uint64_t tohost __attribute__ ((section (".htif")));
volatile uint64_t fromhost __attribute__ ((section (".htif")));

HTIF_Type htif_handler = {
  .tohost = &tohost,
  .fromhost = &fromhost,
};

int main(void) {
    printf("Hello World! Running XNNPACK FP32 Test\n");

    // Initialize XNNPACK
    int status = xnn_initialize(NULL);
    if (status != xnn_status_success) {
        printf("Failed to initialize XNNPack, status code: %d\n", status);
        return -1;
    }
    printf("XNNPACK initialized successfully!\n");

    // Define parameters for a small Fully Connected layer
    const size_t batch_size = 1;
    const size_t input_channels = 4;
    const size_t output_channels = 3;

    // static float input_data[4] = {1.0f, 2.0f, 3.0f, 4.0f};
    // static float weights[12] = {
    //     0.1f, 0.2f, 0.3f, 0.4f,
    //     0.5f, 0.6f, 0.7f, 0.8f,
    //     0.9f, 1.0f, 1.1f, 1.2f
    // };
    // static float bias[3] = {0.5f, 0.6f, 0.7f};
    // static float output_data[3];

    static float input_data[4] __attribute__((aligned(16))) = {1.0f, 2.0f, 3.0f, 4.0f};
    static float weights[12] __attribute__((aligned(16))) = {
        0.1f, 0.2f, 0.3f, 0.4f,
        0.5f, 0.6f, 0.7f, 0.8f,
        0.9f, 1.0f, 1.1f, 1.2f
    };
    static float bias[3] __attribute__((aligned(16))) = {0.5f, 0.6f, 0.7f};
    static float output_data[3] __attribute__((aligned(16)));

    // Test malloc
    void* test_alloc = malloc(1024);
    if (!test_alloc) {
        printf("malloc failed!\n");
        return -1;
    }
    printf("malloc succeeded!\n");
    free(test_alloc);

    // Create the Fully Connected operator
    xnn_operator_t fc_op = NULL;
    status = xnn_create_fully_connected_nc_f32(
        input_channels,  // Input size per batch
        output_channels, // Output size per batch
        input_channels,  // Input stride
        output_channels, // Output stride
        weights,         // Weights matrix
        bias,            // Bias vector
        -INFINITY,       // Min activation
        INFINITY,        // Max activation
        0,               // Flags
        NULL,            // Code cache
        NULL,            // Weights cache
        &fc_op);

    if (status != xnn_status_success) {
        printf("Failed to create Fully Connected operator, status code: %d\n", status);
        return -1;
    }

    // Setup the operator
    status = xnn_setup_fully_connected_nc_f32(fc_op, input_data, output_data);
    if (status != xnn_status_success) {
        printf("Failed to setup Fully Connected operator, status code: %d\n", status);
        xnn_delete_operator(fc_op);
        return -1;
    }

    // Run the operator
    status = xnn_run_operator(fc_op, NULL);
    if (status != xnn_status_success) {
        printf("Failed to run Fully Connected operator, status code: %d\n", status);
        xnn_delete_operator(fc_op);
        return -1;
    }

    // Print results
    printf("Fully Connected Output:\n");
    for (size_t i = 0; i < output_channels; i++) {
        printf("%f ", (double)output_data[i]);  // Explicitly cast to avoid warnings
    }
    printf("\n");

    // Cleanup
    xnn_delete_operator(fc_op);
    return 0;
}
```
