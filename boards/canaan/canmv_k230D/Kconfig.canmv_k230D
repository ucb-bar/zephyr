## boards/canaan/canmv_k230D/Kconfig.canmv_k230D
```kconfig
# Copyright (c) 2024 Junhui Liu <liujh2818@outlook.com>
# SPDX-License-Identifier: Apache-2.0

config BOARD_CANMV_K230D
	select SOC_CANAAN_K230
```
